## main/Kconfig.projbuild
```kconfig
menu "Example Configuration"

    config LIGHT1_GPIO
        int "LIGHT 1 GPIO"
        range 0 34
        default 32
        help
            Choose the GPIO pin number for light barrier 1.
                
    config LIGHT2_GPIO
        int "LIGHT 2 GPIO"
        range 0 34
        default 33
        help
            Choose the GPIO pin number for light barrier 2.
            
    config ESP_WIFI_SSID
        string "WiFi SSID"
        default "CAPS-Seminar-Room"
        help
            SSID (network name) for the example to connect to.
        
    config ESP_WIFI_PASSWORD
        string "WiFi Password"
        default "caps-schulz-seminar-room-wifi"
        help
            WiFi password (WPA or WPA2) for the example to use.
        
    config ESP_MAXIMUM_RETRY
        int "Maximum retry"
        default 5
        help
            Set the Maximum retry to avoid station reconnecting to the AP unlimited when the AP is really inexistent.
        
endmenu
```
